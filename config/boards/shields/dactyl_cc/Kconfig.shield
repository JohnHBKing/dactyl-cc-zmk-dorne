## config/boards/shields/dactyl_cc/Kconfig.shield
```kconfig
config SHIELD_DORNE_DONGLE
    def_bool $(shields_list_contains,dorne_dongle)

config SHIELD_DACTYL_CC_LEFT
    def_bool $(shields_list_contains,dactyl_cc_left)

config SHIELD_DACTYL_CC_RIGHT
    def_bool $(shields_list_contains,dactyl_cc_right)
```
